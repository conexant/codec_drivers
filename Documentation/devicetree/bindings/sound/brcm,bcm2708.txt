## Documentation/devicetree/bindings/sound/cnxt,cx2072x-evk-audio.txt
```
Conexant System - cx2072x audio codec.

Required properties:

- compatible - "string" - One of:
    "cnxt,cx2072x-evk-audio" - cx2072x audio codec device


Optional properties:

- ti,hp-det-gpio - gpio pin number used for jack detection notification
- ti,codec-clock-rate - system clock used for codec's MCLK rate

Example:

sound {
	compatible = "cnxt,cx2072x-evm-audio";
	ti,codec-clock-rate = <24000000>;
	ti,hp-det-gpio = <&gpio3 19 0x1>;
};
```

## Documentation/devicetree/bindings/sound/cnxt,cx20810.txt
```
Conexant CX2081X HD Voice Capture

The devices supports the I2C bus.

Required properties:

  - compatible: One of "cnxt,cx20810".
  - reg: The I2C address of the device for I2C, it should be <0x3B>

Example:

codec_i2c: cx20810@3b {
	compatible = "cnxt,cx20810";
	reg = <0x3b>;
};
```

## Documentation/devicetree/bindings/sound/cnxt,cx20811.txt
```
Conexant CX2081X HD Voice Capture

The devices supports the I2C bus.

Required properties:

  - compatible: One of "cnxt,cx20811".
  - reg: The I2C address of the device for I2C, it should be <0x3B>

Example:

codec_i2c: cx20811@3b {
	compatible = "cnxt,cx20811";
	reg = <0x3b>;
};
```

## Documentation/devicetree/bindings/sound/cnxt,cx20823.txt
```
Conexant CX20823 Mono ADC

The devices supports the I2C bus.

Required properties:

  - compatible: One of "cnxt,cx20823".
  - reg: The I2C address of the device for I2C, it should be <0x44>

Example:

codec_i2c: cx20823@44 {
	compatible = "cnxt,cx20823";
	reg = <0x44>;
};
```

## Documentation/devicetree/bindings/sound/cnxt,cx2092x.txt
```
Conexant CX20921/CX209724 Voice Processor DSP

The devices supports both the I2C and SPI bus.

Required properties:

  - compatible: One of "cnxt,cx20921", "cnxt,cx20924".
  - reg: The I2C address of the device for I2C, it should be <0x41>

Optional properties:

  - reset-gpios: A GPIO spec to define which pin is connected to the chip's
		 !RESET pin. If specified, the driver will assert a hardware
		 reset at probe time.

CODEC input pins:
  "MIC"	- Microphone input

Example:

codec_i2c: cx20921@41 {
	compatible = "cnxt,cx20921";
	reg = <0x41>;
	reset-gpios = <&gpio1 23 0>;
};

codec_spi: cx20924@0 {
	compatible = "cnxt,cx20924";
};
```

## Documentation/devicetree/bindings/sound/cnxt,cx9000-pi-i2s.txt
```
Conexant audio with Smart Amplifier 2.

Required properties:

- compatible                            : "cnxt,cx9000-pi-i2s"
```

## Documentation/devicetree/bindings/sound/cnxt,cxsmtspk-pi-i2s.txt
```
Conexant audio with Smart Speaker I2S codec.

Required properties:

- compatible                            : "cnxt,cxsmtspk-pi-i2s"
```

## Documentation/devicetree/bindings/sound/cnxt,cxsmtspk-pi-usb.txt
```
Conexant audio with Smart Speaker USB codec.

Required properties:

- compatible                            : "cnxt,cxsmtspk-pi-usb"
```

## Documentation/devicetree/bindings/sound/simple-card-plus.txt
```
Simple-Card-Plus:

Simple-Card-Plus specifies audio DAI connections of SoC <-> codec and codec <-> codec.

Required properties:

- compatible				: "simple-audio-card-plus"

Optional properties:

- simple-audio-card,name		: User specified audio sound card name, one string
					  property.
- simple-audio-card,widgets		: Please refer to widgets.txt.
- simple-audio-card,routing		: A list of the connections between audio components.
					  Each entry is a pair of strings, the first being the
					  connection's sink, the second being the connection's
					  source.
- simple-audio-card,mclk-fs             : Multiplication factor between stream rate and codec
					  mclk. When defined, mclk-fs property defined in
					  dai-link sub nodes are ignored.
- simple-audio-card,hp-det-gpio		: Reference to GPIO that signals when
					  headphones are attached.
- simple-audio-card,mic-det-gpio	: Reference to GPIO that signals when
					  a microphone is attached.

Optional subnodes:

- simple-audio-card,dai-link		: Container for dai-link level
					  properties and the CPU and CODEC
					  sub-nodes. This container may be
					  omitted when the card has only one
					  DAI link. See the examples and the
					  section bellow.

Dai-link subnode properties and subnodes:

If dai-link subnode is omitted and the subnode properties are directly
under "sound"-node the subnode property and subnode names have to be
prefixed with "simple-audio-card,"-prefix.

Required dai-link subnodes:

- cpu					: CPU   sub-node
- codec					: CODEC sub-node

Optional dai-link subnode properties:

- format				: CPU/CODEC common audio format.
					  "i2s", "right_j", "left_j" , "dsp_a"
					  "dsp_b", "ac97", "pdm", "msb", "lsb"
- frame-master				: Indicates dai-link frame master.
					  phandle to a cpu or codec subnode.
- bitclock-master			: Indicates dai-link bit clock master.
					  phandle to a cpu or codec subnode.
- bitclock-inversion			: bool property. Add this if the
					  dai-link uses bit clock inversion.
- frame-inversion			: bool property. Add this if the
					  dai-link uses frame clock inversion.
- mclk-fs             			: Multiplication factor between stream
					  rate and codec mclk, applied only for
					  the dai-link.

For backward compatibility the frame-master and bitclock-master
properties can be used as booleans in codec subnode to indicate if the
codec is the dai-link frame or bit clock master. In this case there
should be no dai-link node, the same properties should not be present
at sound-node level, and the bitclock-inversion and frame-inversion
properties should also be placed in the codec node if needed.

Required CPU/CODEC subnodes properties:

- sound-dai				: phandle and port of CPU/CODEC

Optional CPU/CODEC subnodes properties:

- dai-tdm-slot-num			: Please refer to tdm-slot.txt.
- dai-tdm-slot-width			: Please refer to tdm-slot.txt.
- clocks / system-clock-frequency	: specify subnode's clock if needed.
					  it can be specified via "clocks" if system has
					  clock node (= common clock), or "system-clock-frequency"
					  (if system doesn't support common clock)
					  If a clock is specified, it is
					  enabled with clk_prepare_enable()
					  in dai startup() and disabled with
					  clk_disable_unprepare() in dai
					  shutdown().
- system-clock-direction		: "in" or "out", default "in"
- system-clock-id			: Numberic ID of the system clock to
					  select within the dai, default is 0.

Example 1 - single DAI link:

sound {
	compatible = "simple-audio-card-plus";
	simple-audio-card,name = "";
	simple-audio-card,format = "left_j";
	simple-audio-card,bitclock-master = <&dailink0_master>;
	simple-audio-card,frame-master = <&dailink0_master>;
		simple-audio-card,routing =
		"Headphone Jack", "PORTA",
		"Ext Spk", "PORTG",
		"PORTB", "Headset Mic";
	simple-audio-card,widgets =
		"Headphone", "Headphone Jack",
		"Speaker", "Ext Spk",
		"Microphone", "Headset Mic";

	dailink0_master: simple-audio-card,cpu {
		sound-dai = <&i2s>;
		system-clock-frequence = <12288000>
		system-clock-direction = "in"
	};

	simple-audio-card,codec {
		sound-dai = <&cx2072x 0>;
		system-clock-frequence = <12288000>
		system-clock-direction = "in"
	};
};

&i2c1 {
	cx2072x: cx2072x@33 {
		#sound-dai-cells = <1>;
		compatible = "cnxt,cx20721";
		reg = <0x33>;
		clocks = <&clk_mcasp0>;
		clock-names = "mclk";
		status = "okay";
	};
};

&i2s	{
	status = "okay";
};

Example 2 - many DAI links:

&i2c1 {
	cx2072x: cx2072x@33 {
		#sound-dai-cells = <1>;
		compatible = "cnxt,cx20721";
		reg = <0x33>;
		clocks = <&clk_mcasp0>;
		clock-names = "mclk";
		status = "okay";
	};

	cx2092x: cx2092x@41 {
		#sound-dai-cells = <1>;
		compatible = "cnxt,cx20924";
		reg = <0x41>;
		status = "okay";
	};
};

sound {
	compatible = "simple-audio-card-plus";
	simple-audio-card,name = "cx-smart-speaker";

	simple-audio-card,dai-link@0 {   /* I2S1 - CX2072X-DSP */
		format = "i2s";
		cpu {
			sound-dai = <&i2s>;
		};
		codec {
			sound-dai = <&cx2072x 1>;
		};
		plat {
			sound-dai = <&i2s>;
		};
	};

	simple-audio-card,dai-link@1 {   /* CX2072X-AEC - CX2092X-DSP */
		cpu {
			sound-dai = <&cx2072x 2>;
		};
		codec {
			sound-dai = <&cx2092x 1>;
		};
	};

	simple-audio-card,dai-link@2 {   /* I2S1 - CX2092X-AIF */
		cpu {
			sound-dai = <&i2s>;
		};
		codec {
			sound-dai = <&cx2092x 0>;
		};
		plat {
			sound-dai = <&i2s>;
		};
	};
};
```

## sound/soc/generic/Kconfig
```kconfig
config SND_SIMPLE_CARD
	tristate "ASoC Simple sound card support"
	help
	  This option enables generic simple sound card support

config SND_SIMPLE_CARD_PLUS
	tristate "ASoC Simple sound card plus support"
	help
	  This option enables generic simple sound card plus support
```
